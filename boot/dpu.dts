/dts-v1/;
// Device Tree: describes hardware the kernel can't probe — addresses, IRQs.
// The kernel reads this instead of hard-coding board details in C.
/ {
    compatible = "dpu,refboard";
    #address-cells = <1>;
    #size-cells = <1>;

    // The DPU networking/compute engine, at a fixed MMIO address.
    dpu_engine@40000000 {
        compatible = "dpu,engine-v1";
        reg = <0x40000000 0x1000>;   // base address, size (one page)
        interrupts = <0 42 4>;       // IRQ 42, level-triggered
    };
};
